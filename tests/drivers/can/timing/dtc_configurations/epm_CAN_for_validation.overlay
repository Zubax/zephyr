/ {
    soc {
        can {
           std-filter-elements = <28>;
            ext-filter-elements = <8>;
            rx-fifo0-elements = <3>;
            rx-fifo1-elements = <3>;
            rx-buffer-elements = <0>;
            tx-buffer-elements = <1>;
        };
    };
};
