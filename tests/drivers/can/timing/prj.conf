## CMakeLists.txt
```
# SPDX-License-Identifier: Apache-2.0

cmake_minimum_required(VERSION 3.20.0)


get_filename_component(APPLICATION_PROJECT_DIR
        ${CMAKE_CURRENT_LIST_DIR}/../../../../../epm
        ABSOLUTE
        )

get_filename_component(ONTARGET_DIR
        ${CMAKE_CURRENT_LIST_DIR}/../../../../../verification/on_target
        ABSOLUTE
        )

set(DTC_OVERLAY_FILE ${CMAKE_CURRENT_LIST_DIR}/dtc_configurations/epm_CAN_for_validation.overlay)

# Add this project to list of board roots
list(APPEND BOARD_ROOT ${APPLICATION_PROJECT_DIR})

find_package(Zephyr REQUIRED HINTS $ENV{ZEPHYR_BASE})
project(can_timing)

target_sources(app PRIVATE src/main.c)
target_sources(app PRIVATE src/semihost_extra.c)
zephyr_include_directories(${CMAKE_CURRENT_LIST_DIR}/src)
```

## prj.conf
```kconfig
CONFIG_CAN=y
CONFIG_CAN_FD_MODE=y
CONFIG_CAN_AUTO_BUS_OFF_RECOVERY=n
CONFIG_TEST_USERSPACE=y
CONFIG_ZTEST=y
CONFIG_ZTEST_NEW_API=y
CONFIG_ZTEST_VERBOSE_OUTPUT=y
CONFIG_ZTEST_ASSERT_VERBOSE=1
# The canfd test suite may be skipped
CONFIG_ZTEST_VERIFY_RUN_ALL=n
CONFIG_SEMIHOST=y
CONFIG_ZTEST_TC_UTIL_USER_OVERRIDE=y
CONFIG_ZTEST_STACK_SIZE=4096
```

## src/semihost_extra.c
```c
#include <zephyr/arch/common/semihost.h>
#include <stdarg.h>
#include <zephyr/kernel.h>

void semihost_log(const char* fmt, ...)
{
    char    buf[256];
    va_list args;
    va_start(args, fmt);
    const int len = vsnprintk(buf, sizeof(buf), fmt, args);
    va_end(args);
    const char* const path = "./test_results/test_log.txt";
    const int         fd   = semihost_open(path, SEMIHOST_OPEN_A);
    if ((fd < 0) || (semihost_write(fd, buf, len) < 0))
    {
        // Semihost I/O is a vital component of the test suite. There is no sensible
        // failure management policy in existence, so we simply abort execution.
        k_panic();
    }
    (void) semihost_close(fd);
}
```
